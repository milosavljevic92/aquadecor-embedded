
; PICBASIC PRO(TM) Compiler 3.0.4.1, (c) 1998, 2011 microEngineering Labs, Inc. All Rights Reserved. 
MPASMWIN_USED			EQU	1

#define	PBP_PATH	C:\PBP3\




        NOLIST
    ifdef PM_USED
        LIST
        "Error: PM does not support this device.  Use MPASM."
        NOLIST
    else
        LIST
        LIST p = 18F25K22, r = dec, w = -311, w = -230, f = inhx32
        INCLUDE "P18F25K22.INC"	; MPASM  Header
        NOLIST
    endif
        LIST
EEPROM_START	EQU	0F00000h
BLOCK_SIZE	EQU	64


PBP_HARDWAREDEF  macro
  endm


  CONFIG HFOFST   = ON
    CONFIG FOSC     = INTIO67
    CONFIG PLLCFG   = OFF
    CONFIG IESO     = OFF
    CONFIG PWRTEN   = OFF
    CONFIG BOREN    = OFF
    CONFIG WDTEN    = OFF
    CONFIG MCLRE    = INTMCLR
    CONFIG XINST    = OFF
    CONFIG CCP2MX   = PORTB3
    CONFIG T3CMX    = PORTB5
    CONFIG PBADEN   = OFF 
  



; Define statements.
; C:\PBP3\DEVICES\PIC18F25K22.PBPINC	00299	DEFINE  ADC_CHANNELS  1
#define		ADC_CHANNELS		  1
; C:\USERS\DAMIR\DESKTOP\DANER\TEST\TESTPROGRAM.PBP	00002	define OSC 16
#define		OSC		 16
; C:\USERS\DAMIR\DESKTOP\DANER\TEST\TESTPROGRAM.PBP	00022	DEFINE LCD_DREG PORTA 
#define		LCD_DREG		 PORTA 
; C:\USERS\DAMIR\DESKTOP\DANER\TEST\TESTPROGRAM.PBP	00023	DEFINE LCD_DBIT 0
#define		LCD_DBIT		 0
; C:\USERS\DAMIR\DESKTOP\DANER\TEST\TESTPROGRAM.PBP	00024	DEFINE LCD_RSREG PORTA
#define		LCD_RSREG		 PORTA
; C:\USERS\DAMIR\DESKTOP\DANER\TEST\TESTPROGRAM.PBP	00025	DEFINE LCD_RSBIT 5 
#define		LCD_RSBIT		 5 
; C:\USERS\DAMIR\DESKTOP\DANER\TEST\TESTPROGRAM.PBP	00026	DEFINE LCD_EREG PORTA
#define		LCD_EREG		 PORTA
; C:\USERS\DAMIR\DESKTOP\DANER\TEST\TESTPROGRAM.PBP	00027	DEFINE LCD_EBIT 4 
#define		LCD_EBIT		 4 
; C:\USERS\DAMIR\DESKTOP\DANER\TEST\TESTPROGRAM.PBP	00028	DEFINE LCD_BITS 4 
#define		LCD_BITS		 4 
; C:\USERS\DAMIR\DESKTOP\DANER\TEST\TESTPROGRAM.PBP	00029	DEFINE LCD_LINE 2
#define		LCD_LINE		 2
; C:\USERS\DAMIR\DESKTOP\DANER\TEST\TESTPROGRAM.PBP	00031	DEFINE I2C_SCLOUT 1
#define		I2C_SCLOUT		 1

RAM_START       		EQU	00000h
RAM_END         		EQU	005FFh
RAM_BANKS       		EQU	00006h
BANK0_START     		EQU	00060h
BANK0_END       		EQU	000FFh
BANK1_START     		EQU	00100h
BANK1_END       		EQU	001FFh
BANK2_START     		EQU	00200h
BANK2_END       		EQU	002FFh
BANK3_START     		EQU	00300h
BANK3_END       		EQU	003FFh
BANK4_START     		EQU	00400h
BANK4_END       		EQU	004FFh
BANK5_START     		EQU	00500h
BANK5_END       		EQU	005FFh
BANKA_START     		EQU	00000h
BANKA_END       		EQU	0005Fh

; C:\PBP3\PBPPI18L.RAM     	00028	A00000	FLAGS   VAR     BYTE BANKA SYSTEM       ' Static flags
FLAGS           		EQU	RAM_START + 000h
; C:\PBP3\PBPPI18L.RAM     	00027	A00001	GOP     VAR     BYTE BANKA SYSTEM       ' Gen Op Parameter
GOP             		EQU	RAM_START + 001h
; C:\PBP3\PBPPI18L.RAM     	00016	A00002	R4      VAR     WORD BANKA SYSTEM       ' System Register
R4              		EQU	RAM_START + 002h
; C:\PBP3\PBPPI18L.RAM     	00017	A00004	R5      VAR     WORD BANKA SYSTEM       ' System Register
R5              		EQU	RAM_START + 004h
; C:\PBP3\PBPPI18L.RAM     	00018	A00006	R6      VAR     WORD BANKA SYSTEM       ' System Register
R6              		EQU	RAM_START + 006h
; C:\PBP3\PBPPI18L.RAM     	00019	A00008	R7      VAR     WORD BANKA SYSTEM       ' System Register
R7              		EQU	RAM_START + 008h
; C:\PBP3\PBPPI18L.RAM     	00020	A0000A	R8      VAR     WORD BANKA SYSTEM       ' System Register
R8              		EQU	RAM_START + 00Ah
; C:\PBP3\PBPPI18L.RAM     	00023	A0000C	RM1     VAR     BYTE BANKA SYSTEM       ' Pin 1 Mask
RM1             		EQU	RAM_START + 00Ch
; C:\PBP3\PBPPI18L.RAM     	00026	A0000D	RM2     VAR     BYTE BANKA SYSTEM       ' Pin 2 Mask
RM2             		EQU	RAM_START + 00Dh
; C:\PBP3\PBPPI18L.RAM     	00021	A0000E	RR1     VAR     BYTE BANKA SYSTEM       ' Pin 1 Register
RR1             		EQU	RAM_START + 00Eh
; C:\PBP3\PBPPI18L.RAM     	00024	A0000F	RR2     VAR     BYTE BANKA SYSTEM       ' Pin 2 Register
RR2             		EQU	RAM_START + 00Fh
; C:\PBP3\PBPPI18L.RAM     	00022	A00010	RS1     VAR     BYTE BANKA SYSTEM       ' Pin 1 Bank
RS1             		EQU	RAM_START + 010h
; C:\PBP3\PBPPI18L.RAM     	00025	A00011	RS2     VAR     BYTE BANKA SYSTEM       ' Pin 2 Bank
RS2             		EQU	RAM_START + 011h
; C:\PBP3\PBPPI18L.RAM     	00012	A00012	R0      VAR     LONG BANKA SYSTEM       ' System Register
R0              		EQU	RAM_START + 012h
; C:\PBP3\PBPPI18L.RAM     	00013	A00016	R1      VAR     LONG BANKA SYSTEM       ' System Register
R1              		EQU	RAM_START + 016h
; C:\PBP3\PBPPI18L.RAM     	00014	A0001A	R2      VAR     LONG BANKA SYSTEM       ' System Register
R2              		EQU	RAM_START + 01Ah
; C:\PBP3\PBPPI18L.RAM     	00015	A0001E	R3      VAR     LONG BANKA SYSTEM       ' System Register
R3              		EQU	RAM_START + 01Eh
; C:\USERS\DAMIR\DESKTOP\DANER\TEST\TESTPROGRAM.PBP	00001	A00022	
T1              		EQU	RAM_START + 022h
; C:\USERS\DAMIR\DESKTOP\DANER\TEST\TESTPROGRAM.PBP	00001	A00026	
T2              		EQU	RAM_START + 026h
; C:\USERS\DAMIR\DESKTOP\DANER\TEST\TESTPROGRAM.PBP	00098	A0002A	Adr             var word
_Adr             		EQU	RAM_START + 02Ah
; C:\USERS\DAMIR\DESKTOP\DANER\TEST\TESTPROGRAM.PBP	00095	A0002C	DutyCycleL      VAR WORD
_DutyCycleL      		EQU	RAM_START + 02Ch
; C:\USERS\DAMIR\DESKTOP\DANER\TEST\TESTPROGRAM.PBP	00094	A0002E	Frequency       VAR WORD
_Frequency       		EQU	RAM_START + 02Eh
; C:\USERS\DAMIR\DESKTOP\DANER\TEST\HPWM10_L.PBP	00047	A00030	HP_Duty      VAR WORD
_HP_Duty         		EQU	RAM_START + 030h
; C:\USERS\DAMIR\DESKTOP\DANER\TEST\HPWM10_L.PBP	00046	A00032	HP_Freq      VAR Word
_HP_Freq         		EQU	RAM_START + 032h
; C:\USERS\DAMIR\DESKTOP\DANER\TEST\HPWM10_L.PBP	00048	A00034	HP_Temp      VAR WORD
_HP_Temp         		EQU	RAM_START + 034h
; C:\USERS\DAMIR\DESKTOP\DANER\TEST\TESTPROGRAM.PBP	00096	A00036	Merenje         var word
_Merenje         		EQU	RAM_START + 036h
; C:\USERS\DAMIR\DESKTOP\DANER\TEST\TESTPROGRAM.PBP	00093	A00038	Potenciometar   VAR word
_Potenciometar   		EQU	RAM_START + 038h
; C:\USERS\DAMIR\DESKTOP\DANER\TEST\TESTPROGRAM.PBP	00088	A0003A	Days            var byte
_Days            		EQU	RAM_START + 03Ah
; C:\USERS\DAMIR\DESKTOP\DANER\TEST\TESTPROGRAM.PBP	00087	A0003B	Hours           var byte
_Hours           		EQU	RAM_START + 03Bh
; C:\USERS\DAMIR\DESKTOP\DANER\TEST\HPWM10_L.PBP	00045	A0003C	HP_Channel   VAR BYTE
_HP_Channel      		EQU	RAM_START + 03Ch
; C:\USERS\DAMIR\DESKTOP\DANER\TEST\HPWM10_L.PBP	00039	A0003D	HP_Flags  VAR BYTE
_HP_Flags        		EQU	RAM_START + 03Dh
; C:\USERS\DAMIR\DESKTOP\DANER\TEST\HPWM10_L.PBP	00049	A0003E	HP_PR2       VAR BYTE
_HP_PR2          		EQU	RAM_START + 03Eh
; C:\USERS\DAMIR\DESKTOP\DANER\TEST\TESTPROGRAM.PBP	00050	A0003F	LMcnt var byte            
_LMcnt           		EQU	RAM_START + 03Fh
; C:\USERS\DAMIR\DESKTOP\DANER\TEST\TESTPROGRAM.PBP	00086	A00040	Minutes         var byte
_Minutes         		EQU	RAM_START + 040h
; C:\USERS\DAMIR\DESKTOP\DANER\TEST\TESTPROGRAM.PBP	00090	A00041	Month           var byte
_Month           		EQU	RAM_START + 041h
; C:\USERS\DAMIR\DESKTOP\DANER\TEST\TESTPROGRAM.PBP	00100	A00042	 poti var byte
_poti            		EQU	RAM_START + 042h
; C:\USERS\DAMIR\DESKTOP\DANER\TEST\TESTPROGRAM.PBP	00085	A00043	Seconds         var byte
_Seconds         		EQU	RAM_START + 043h
; C:\USERS\DAMIR\DESKTOP\DANER\TEST\TESTPROGRAM.PBP	00091	A00044	Temp            var byte
_Temp            		EQU	RAM_START + 044h
; C:\USERS\DAMIR\DESKTOP\DANER\TEST\TESTPROGRAM.PBP	00092	A00045	Temperatura     var byte  
_Temperatura     		EQU	RAM_START + 045h
; C:\USERS\DAMIR\DESKTOP\DANER\TEST\TESTPROGRAM.PBP	00084	A00046	X               VAR BYTE
_X               		EQU	RAM_START + 046h
; C:\USERS\DAMIR\DESKTOP\DANER\TEST\TESTPROGRAM.PBP	00089	A00047	Years           var byte
_Years           		EQU	RAM_START + 047h
; C:\PBP3\DEVICES\PIC18F25K22.PBPINC	00300	PORTL   VAR     PORTB
_PORTL           		EQU	 PORTB
; C:\PBP3\DEVICES\PIC18F25K22.PBPINC	00301	PORTH   VAR     PORTC
_PORTH           		EQU	 PORTC
; C:\PBP3\DEVICES\PIC18F25K22.PBPINC	00302	TRISL   VAR     TRISB
_TRISL           		EQU	 TRISB
; C:\PBP3\DEVICES\PIC18F25K22.PBPINC	00303	TRISH   VAR     TRISC
_TRISH           		EQU	 TRISC
_HP_Temp??LOWBYTE		EQU	_HP_Temp
_HP_Temp??HIGHBYTE		EQU	_HP_Temp + 001h
_Potenciometar??LOWBYTE		EQU	_Potenciometar
#define _PS0             	_HP_Flags??0
#define _PS1             	_HP_Flags??1
#define _PSchanged       	_HP_Flags??2
#define _PR2changed      	_HP_Flags??3
#define _TMR2IF          	_PIR1??1
#define _TMR2ON          	_T2CON??2
#define _T2CKPS1         	_T2CON??1
#define _T2CKPS0         	_T2CON??0
#define _BCKLIGHT        	_PORTE??3
#define _SDA             	_PORTC??0
#define _SCL             	_PORTC??1
#define _TASTATURA       	_PORTC??3
#define _RELEJ1          	_PORTC??4
#define _RELEJ2          	_PORTC??5
#define _TX              	_PORTC??6
#define _RX              	_PORTC??7
#define _BUZZER          	_PORTB??1
#define _COPER           	_PORTB??2
#define _SCLK            	_PORTB??4
#define _DIN             	_PORTB??6
#define _CS              	_PORTB??7
#define _tast1           	_PORTA??6
#define _tast2           	_PORTA??7
#define _HP_Flags??0     	_HP_Flags, 000h
#define _HP_Flags??1     	_HP_Flags, 001h
#define _HP_Flags??2     	_HP_Flags, 002h
#define _HP_Flags??3     	_HP_Flags, 003h
#define _PIR1??1         	 PIR1, 001h
#define _T2CON??2        	 T2CON, 002h
#define _T2CON??1        	 T2CON, 001h
#define _T2CON??0        	 T2CON, 000h
#define _PORTE??3        	 PORTE, 003h
#define _PORTC??0        	 PORTC, 000h
#define _PORTC??1        	 PORTC, 001h
#define _PORTC??3        	 PORTC, 003h
#define _PORTC??4        	 PORTC, 004h
#define _PORTC??5        	 PORTC, 005h
#define _PORTC??6        	 PORTC, 006h
#define _PORTC??7        	 PORTC, 007h
#define _PORTB??1        	 PORTB, 001h
#define _PORTB??2        	 PORTB, 002h
#define _PORTB??4        	 PORTB, 004h
#define _PORTB??6        	 PORTB, 006h
#define _PORTB??7        	 PORTB, 007h
#define _PORTA??6        	 PORTA, 006h
#define _PORTA??7        	 PORTA, 007h
#define _Minutes??7      	_Minutes, 007h
#define _Hours??7        	_Hours, 007h
#define _Hours??6        	_Hours, 006h
#define _Days??7         	_Days, 007h
#define _Days??6         	_Days, 006h
#define _Month??7        	_Month, 007h
#define _Month??6        	_Month, 006h
#define _Month??5        	_Month, 005h
#define _Potenciometar??9	_Potenciometar + 001h, 001h

; Constants.
_RTC             		EQU	000A2h
_EPROM           		EQU	000A0h
_LM75            		EQU	00090h

; EEPROM data.


	INCLUDE	"TESTPROGRAM.MAC"
	INCLUDE	"C:\PBP3\PBPPI18L.LIB"


; C:\PBP3\DEVICES\PIC18F25K22.PBPINC	00036	#HEADER
; C:\PBP3\DEVICES\PIC18F25K22.PBPINC	00062	#CONFIG
; C:\PBP3\DEVICES\PIC18F25K22.PBPINC	00282	BANKA   $0000, $005F
; C:\PBP3\DEVICES\PIC18F25K22.PBPINC	00283	BANK0   $0060, $00FF
; C:\PBP3\DEVICES\PIC18F25K22.PBPINC	00284	BANK1   $0100, $01FF
; C:\PBP3\DEVICES\PIC18F25K22.PBPINC	00285	BANK2   $0200, $02FF
; C:\PBP3\DEVICES\PIC18F25K22.PBPINC	00286	BANK3   $0300, $03FF
; C:\PBP3\DEVICES\PIC18F25K22.PBPINC	00287	BANK4   $0400, $04FF
; C:\PBP3\DEVICES\PIC18F25K22.PBPINC	00288	BANK5   $0500, $05FF
; C:\PBP3\DEVICES\PIC18F25K22.PBPINC	00290	'EEPROM  $F00000, $F000FF
; C:\PBP3\DEVICES\PIC18F25K22.PBPINC	00292	    #MSG "LONG Variables enabled (PBPL used)"
; C:\PBP3\DEVICES\PIC18F25K22.PBPINC	00293	    LIBRARY  "PBPPI18L"

; C:\PBP3\DEVICES\PIC18F25K22.PBPINC	00294	    INCLUDE "PBPPI18L.RAM"
; C:\PBP3\DEVICES\PIC18F25K22.PBPINC	00297	    INCLUDE "PBPPIC18.RAM"
; C:\PBP3\DEVICES\PIC18F25K22.PBPINC	00298	#ENDIF
; C:\PBP3\DEVICES\PIC18F25K22.PBPINC	00299	DEFINE  ADC_CHANNELS  1
; C:\PBP3\DEVICES\PIC18F25K22.PBPINC	00307	#HEADER
; C:\USERS\DAMIR\DESKTOP\DANER\TEST\TESTPROGRAM.PBP	00002	define OSC 16
; C:\USERS\DAMIR\DESKTOP\DANER\TEST\TESTPROGRAM.PBP	00003	#CONFIG

; C:\USERS\DAMIR\DESKTOP\DANER\TEST\TESTPROGRAM.PBP	00019	include "HPWM10_L.pbp"

; C:\USERS\DAMIR\DESKTOP\DANER\TEST\HPWM10_L.PBP	00018	disable debug
	DDISABLE?	

; C:\USERS\DAMIR\DESKTOP\DANER\TEST\HPWM10_L.PBP	00019	asm

	ASM?

  if (R1 - R0 == 4)
  else
    messg You must use PBPL
  endif
;____[ HPWM10: 10-bit HPWM, with up to 5 CCP modules ]_____________

HPWM10 macro  Channel, Duty, Freq   
    if Channel < 6 
      MOVE?CB Channel, _HP_Channel      ; Save channel from constant
    else
      MOVE?BB Channel, _HP_Channel      ; Save channel from BYTE var
    endif
    MOVE?WW   Duty, _HP_Duty
    MOVE?WW   Freq, _HP_Freq
    L?CALL    _HPWM10_UPD    
    endm


	ENDASM?


; C:\USERS\DAMIR\DESKTOP\DANER\TEST\HPWM10_L.PBP	00056	goto OverHPWM10
	GOTO?L	_OverHPWM10

; C:\USERS\DAMIR\DESKTOP\DANER\TEST\HPWM10_L.PBP	00058	@PS = ((OSC * 1000000) / 1024)

	ASM?
PS = ((OSC * 1000000) / 1024)

	ENDASM?


; C:\USERS\DAMIR\DESKTOP\DANER\TEST\HPWM10_L.PBP	00059	@PR2const = ((OSC * 1000000) / 4)  ;<----Added

	ASM?
PR2const = ((OSC * 1000000) / 4)  ;<----Added

	ENDASM?

; C:\USERS\DAMIR\DESKTOP\DANER\TEST\HPWM10_L.PBP	00060	PS  CON EXT                        ;<----Added
; C:\USERS\DAMIR\DESKTOP\DANER\TEST\HPWM10_L.PBP	00061	PR2const CON EXT

; C:\USERS\DAMIR\DESKTOP\DANER\TEST\HPWM10_L.PBP	00062	HPWM10_UPD:  

	LABEL?L	_HPWM10_UPD	

; C:\USERS\DAMIR\DESKTOP\DANER\TEST\HPWM10_L.PBP	00064	    HP_Temp = PS / HP_Freq
	DIV?CWW	PS, _HP_Freq, _HP_Temp

; C:\USERS\DAMIR\DESKTOP\DANER\TEST\HPWM10_L.PBP	00065	    if HP_Temp >= 4 then
	CMPLT?WCL	_HP_Temp, 004h, L00003

; C:\USERS\DAMIR\DESKTOP\DANER\TEST\HPWM10_L.PBP	00066	        if PS1 <> 1 then PSchanged = 1 
	CMPEQ?TCL	_PS1, 001h, L00005
	MOVE?CT	001h, _PSchanged
	LABEL?L	L00005	

; C:\USERS\DAMIR\DESKTOP\DANER\TEST\HPWM10_L.PBP	00067	        PS1 = 1
	MOVE?CT	001h, _PS1

; C:\USERS\DAMIR\DESKTOP\DANER\TEST\HPWM10_L.PBP	00068	        if PS0 <> 1 then PSchanged = 1 
	CMPEQ?TCL	_PS0, 001h, L00007
	MOVE?CT	001h, _PSchanged
	LABEL?L	L00007	

; C:\USERS\DAMIR\DESKTOP\DANER\TEST\HPWM10_L.PBP	00069	        PS0 = 1
	MOVE?CT	001h, _PS0

; C:\USERS\DAMIR\DESKTOP\DANER\TEST\HPWM10_L.PBP	00070	    else
	GOTO?L	L00004
	LABEL?L	L00003	

; C:\USERS\DAMIR\DESKTOP\DANER\TEST\HPWM10_L.PBP	00071	        if PS1 <> 0 then PSchanged = 1 
	CMPEQ?TCL	_PS1, 000h, L00009
	MOVE?CT	001h, _PSchanged
	LABEL?L	L00009	

; C:\USERS\DAMIR\DESKTOP\DANER\TEST\HPWM10_L.PBP	00072	        PS1 = 0
	MOVE?CT	000h, _PS1

; C:\USERS\DAMIR\DESKTOP\DANER\TEST\HPWM10_L.PBP	00073	        if HP_Temp > 0 then 
	CMPLE?WCL	_HP_Temp, 000h, L00011

; C:\USERS\DAMIR\DESKTOP\DANER\TEST\HPWM10_L.PBP	00074	            if PS0 <> 1 then PSchanged = 1 
	CMPEQ?TCL	_PS0, 001h, L00013
	MOVE?CT	001h, _PSchanged
	LABEL?L	L00013	

; C:\USERS\DAMIR\DESKTOP\DANER\TEST\HPWM10_L.PBP	00075	            PS0 = 1
	MOVE?CT	001h, _PS0

; C:\USERS\DAMIR\DESKTOP\DANER\TEST\HPWM10_L.PBP	00076	        else
	GOTO?L	L00012
	LABEL?L	L00011	

; C:\USERS\DAMIR\DESKTOP\DANER\TEST\HPWM10_L.PBP	00077	            if PS0 <> 0 then PSchanged = 1 
	CMPEQ?TCL	_PS0, 000h, L00015
	MOVE?CT	001h, _PSchanged
	LABEL?L	L00015	

; C:\USERS\DAMIR\DESKTOP\DANER\TEST\HPWM10_L.PBP	00078	            PS0 = 0
	MOVE?CT	000h, _PS0

; C:\USERS\DAMIR\DESKTOP\DANER\TEST\HPWM10_L.PBP	00079	        endif
	LABEL?L	L00012	

; C:\USERS\DAMIR\DESKTOP\DANER\TEST\HPWM10_L.PBP	00080	    endif
	LABEL?L	L00004	

; C:\USERS\DAMIR\DESKTOP\DANER\TEST\HPWM10_L.PBP	00091	    HP_Temp =PR2const/HP_Freq 'DIV32 HP_Freq <-------------------changed
	DIV?CWW	PR2const, _HP_Freq, _HP_Temp

; C:\USERS\DAMIR\DESKTOP\DANER\TEST\HPWM10_L.PBP	00093	    if PS0 then HP_Temp = HP_Temp >> 2  ; /4
	CMPF?TL	_PS0, L00017
	SHIFTR?WCW	_HP_Temp, 002h, _HP_Temp
	LABEL?L	L00017	

; C:\USERS\DAMIR\DESKTOP\DANER\TEST\HPWM10_L.PBP	00094	    if PS1 then HP_Temp = HP_Temp >> 2  ; /4 or 16
	CMPF?TL	_PS1, L00019
	SHIFTR?WCW	_HP_Temp, 002h, _HP_Temp
	LABEL?L	L00019	

; C:\USERS\DAMIR\DESKTOP\DANER\TEST\HPWM10_L.PBP	00095	    HP_PR2 = HP_Temp.lowbyte - 1
	SUB?BCB	_HP_Temp??LOWBYTE, 001h, _HP_PR2

; C:\USERS\DAMIR\DESKTOP\DANER\TEST\HPWM10_L.PBP	00096	    if HP_PR2 <> PR2 then PR2changed = 1
	CMPEQ?BBL	_HP_PR2, PR2, L00021
	MOVE?CT	001h, _PR2changed
	LABEL?L	L00021	

; C:\USERS\DAMIR\DESKTOP\DANER\TEST\HPWM10_L.PBP	00100	    HP_Temp = (HP_PR2 + 1) << 2  ; * 4
	ADD?BCN	_HP_PR2, 001h, T1
	SHIFTL?NCW	T1, 002h, _HP_Temp

; C:\USERS\DAMIR\DESKTOP\DANER\TEST\HPWM10_L.PBP	00102	    HP_Duty = (HP_Temp * HP_Duty)/1023 'DIV32 1023 <-------------------changed
	MUL?WWN	_HP_Temp, _HP_Duty, T1
	DIV?NCW	T1, 0000003FFh, _HP_Duty

; C:\USERS\DAMIR\DESKTOP\DANER\TEST\HPWM10_L.PBP	00107	    Branch HP_Channel,[GetCH_Done,GetCH_1,GetCH_2,GetCH_3,GetCH_4,GetCH_5]
	BRANCH?BCL	_HP_Channel, 006h, L00001
	BRGOTO?L	_GetCH_Done
	BRGOTO?L	_GetCH_1
	BRGOTO?L	_GetCH_2
	BRGOTO?L	_GetCH_3
	BRGOTO?L	_GetCH_4
	BRGOTO?L	_GetCH_5

	LABEL?L	L00001	

; C:\USERS\DAMIR\DESKTOP\DANER\TEST\HPWM10_L.PBP	00109	    GetCH_1:

	LABEL?L	_GetCH_1	

; C:\USERS\DAMIR\DESKTOP\DANER\TEST\HPWM10_L.PBP	00110	            ASM

	ASM?

              ifdef CCP1CON  
                MOVE?BB  CCPR1L,  _HP_Temp
                MOVE?BB  CCP1CON, _HP_Temp + 1
                goto _GetCH_Done        
              endif  
            

	ENDASM?


; C:\USERS\DAMIR\DESKTOP\DANER\TEST\HPWM10_L.PBP	00117	    GetCH_2:  

	LABEL?L	_GetCH_2	

; C:\USERS\DAMIR\DESKTOP\DANER\TEST\HPWM10_L.PBP	00118	            ASM

	ASM?

              ifdef CCP2CON  
                MOVE?BB  CCPR2L,  _HP_Temp
                MOVE?BB  CCP2CON, _HP_Temp + 1
                goto _GetCH_Done        
              endif  
            

	ENDASM?


; C:\USERS\DAMIR\DESKTOP\DANER\TEST\HPWM10_L.PBP	00125	    GetCH_3:  

	LABEL?L	_GetCH_3	

; C:\USERS\DAMIR\DESKTOP\DANER\TEST\HPWM10_L.PBP	00126	            ASM

	ASM?

              ifdef CCP3CON  
                MOVE?BB  CCPR3L,  _HP_Temp
                MOVE?BB  CCP3CON, _HP_Temp + 1
                goto _GetCH_Done        
              endif  
            

	ENDASM?


; C:\USERS\DAMIR\DESKTOP\DANER\TEST\HPWM10_L.PBP	00133	    GetCH_4:  

	LABEL?L	_GetCH_4	

; C:\USERS\DAMIR\DESKTOP\DANER\TEST\HPWM10_L.PBP	00134	            ASM

	ASM?

              ifdef CCP4CON  
                MOVE?BB  CCPR4L,  _HP_Temp
                MOVE?BB  CCP4CON, _HP_Temp + 1
                goto _GetCH_Done        
              endif  
            

	ENDASM?


; C:\USERS\DAMIR\DESKTOP\DANER\TEST\HPWM10_L.PBP	00141	    GetCH_5:  

	LABEL?L	_GetCH_5	

; C:\USERS\DAMIR\DESKTOP\DANER\TEST\HPWM10_L.PBP	00142	            ASM

	ASM?

              ifdef CCP5CON  
                MOVE?BB  CCPR5L,  _HP_Temp
                MOVE?BB  CCP5CON, _HP_Temp + 1
              endif  
            

	ENDASM?


; C:\USERS\DAMIR\DESKTOP\DANER\TEST\HPWM10_L.PBP	00149	GetCH_Done:

	LABEL?L	_GetCH_Done	

; C:\USERS\DAMIR\DESKTOP\DANER\TEST\HPWM10_L.PBP	00150	    HP_Temp = (HP_Temp.lowbyte << 2) | ((HP_Temp.highbyte & %110000) >> 4)
	SHIFTL?BCN	_HP_Temp??LOWBYTE, 002h, T1
	AND?BCN	_HP_Temp??HIGHBYTE, 030h, T2
	SHIFTR?NCN	T2, 004h, T2
	OR?NNW	T1, T2, _HP_Temp

; C:\USERS\DAMIR\DESKTOP\DANER\TEST\HPWM10_L.PBP	00154	    if HP_Temp <> HP_Duty then  ; if DutyCycle Changed
	CMPEQ?WWL	_HP_Temp, _HP_Duty, L00023

; C:\USERS\DAMIR\DESKTOP\DANER\TEST\HPWM10_L.PBP	00156	        HP_Temp = HP_Duty >> 2        ; for CCP?CON
	SHIFTR?WCW	_HP_Duty, 002h, _HP_Temp

; C:\USERS\DAMIR\DESKTOP\DANER\TEST\HPWM10_L.PBP	00157	        HP_Temp.highbyte =  %1100 | ((HP_Duty & %11) << 4)
	AND?WCN	_HP_Duty, 003h, T1
	SHIFTL?NCN	T1, 004h, T1
	OR?CNB	00Ch, T1, _HP_Temp??HIGHBYTE

; C:\USERS\DAMIR\DESKTOP\DANER\TEST\HPWM10_L.PBP	00159	        if TMR2ON then              ; if Timer2 is running
	CMPF?TL	_TMR2ON, L00025

; C:\USERS\DAMIR\DESKTOP\DANER\TEST\HPWM10_L.PBP	00160	            TMR2IF = 0
	MOVE?CT	000h, _TMR2IF

; C:\USERS\DAMIR\DESKTOP\DANER\TEST\HPWM10_L.PBP	00161	            while TMR2IF = 0 : wend ; let current cycle complete
	LABEL?L	L00027	
	CMPNE?TCL	_TMR2IF, 000h, L00028

; C:\USERS\DAMIR\DESKTOP\DANER\TEST\HPWM10_L.PBP	00161	            while TMR2IF = 0 : wend ; let current cycle complete
	GOTO?L	L00027
	LABEL?L	L00028	

; C:\USERS\DAMIR\DESKTOP\DANER\TEST\HPWM10_L.PBP	00162	        endif
	LABEL?L	L00025	

; C:\USERS\DAMIR\DESKTOP\DANER\TEST\HPWM10_L.PBP	00164	        Branch HP_Channel,[PutCH_Done,PutCH_1,PutCH_2,PutCH_3,PutCH_4,PutCH_5]
	BRANCH?BCL	_HP_Channel, 006h, L00002
	BRGOTO?L	_PutCH_Done
	BRGOTO?L	_PutCH_1
	BRGOTO?L	_PutCH_2
	BRGOTO?L	_PutCH_3
	BRGOTO?L	_PutCH_4
	BRGOTO?L	_PutCH_5

	LABEL?L	L00002	

; C:\USERS\DAMIR\DESKTOP\DANER\TEST\HPWM10_L.PBP	00166	        PutCH_1:  

	LABEL?L	_PutCH_1	

; C:\USERS\DAMIR\DESKTOP\DANER\TEST\HPWM10_L.PBP	00167	                ASM

	ASM?

                  ifdef CCP1CON
                    MOVE?BB  _HP_Temp, CCPR1L
                    MOVE?BB  _HP_Temp + 1, CCP1CON
                    goto _PutCH_Done
                  endif  
                

	ENDASM?


; C:\USERS\DAMIR\DESKTOP\DANER\TEST\HPWM10_L.PBP	00174	        PutCH_2:  

	LABEL?L	_PutCH_2	

; C:\USERS\DAMIR\DESKTOP\DANER\TEST\HPWM10_L.PBP	00175	                ASM

	ASM?

                  ifdef CCP2CON  
                    MOVE?BB  _HP_Temp, CCPR2L
                    MOVE?BB  _HP_Temp + 1, CCP2CON
                    goto _PutCH_Done
                  endif  
                

	ENDASM?


; C:\USERS\DAMIR\DESKTOP\DANER\TEST\HPWM10_L.PBP	00182	        PutCH_3:  

	LABEL?L	_PutCH_3	

; C:\USERS\DAMIR\DESKTOP\DANER\TEST\HPWM10_L.PBP	00183	                ASM

	ASM?

                  ifdef CCP3CON  
                    MOVE?BB  _HP_Temp, CCPR3L
                    MOVE?BB  _HP_Temp + 1, CCP3CON
                    goto _PutCH_Done
                  endif  
                

	ENDASM?


; C:\USERS\DAMIR\DESKTOP\DANER\TEST\HPWM10_L.PBP	00190	        PutCH_4:  

	LABEL?L	_PutCH_4	

; C:\USERS\DAMIR\DESKTOP\DANER\TEST\HPWM10_L.PBP	00191	                ASM

	ASM?

                  ifdef CCP4CON  
                    MOVE?BB  _HP_Temp, CCPR4L
                    MOVE?BB  _HP_Temp + 1, CCP4CON
                    goto _PutCH_Done
                  endif  
                

	ENDASM?


; C:\USERS\DAMIR\DESKTOP\DANER\TEST\HPWM10_L.PBP	00198	        PutCH_5:

	LABEL?L	_PutCH_5	

; C:\USERS\DAMIR\DESKTOP\DANER\TEST\HPWM10_L.PBP	00199	                ASM

	ASM?

                  ifdef CCP5CON  
                    MOVE?BB  _HP_Temp, CCPR5L
                    MOVE?BB  _HP_Temp + 1, CCP5CON
                  endif  
                

	ENDASM?


; C:\USERS\DAMIR\DESKTOP\DANER\TEST\HPWM10_L.PBP	00206	    PutCH_Done:

	LABEL?L	_PutCH_Done	

; C:\USERS\DAMIR\DESKTOP\DANER\TEST\HPWM10_L.PBP	00207	    endif
	LABEL?L	L00023	

; C:\USERS\DAMIR\DESKTOP\DANER\TEST\HPWM10_L.PBP	00211	    if TMR2ON = 0 then TMR2ON = 1     ; Start Timer2 if not already running
	CMPNE?TCL	_TMR2ON, 000h, L00029
	MOVE?CT	001h, _TMR2ON
	LABEL?L	L00029	

; C:\USERS\DAMIR\DESKTOP\DANER\TEST\HPWM10_L.PBP	00213	    if (PSchanged | PR2changed) = 1 then
	OR?TTN	_PSchanged, _PR2changed, T1
	CMPNE?NCL	T1, 001h, L00031

; C:\USERS\DAMIR\DESKTOP\DANER\TEST\HPWM10_L.PBP	00214	        TMR2IF = 0
	MOVE?CT	000h, _TMR2IF

; C:\USERS\DAMIR\DESKTOP\DANER\TEST\HPWM10_L.PBP	00215	        while !TMR2IF : wend          ; let current cycle complete
	LABEL?L	L00033	
	CMPT?TL	_TMR2IF, L00034

; C:\USERS\DAMIR\DESKTOP\DANER\TEST\HPWM10_L.PBP	00215	        while !TMR2IF : wend          ; let current cycle complete
	GOTO?L	L00033
	LABEL?L	L00034	

; C:\USERS\DAMIR\DESKTOP\DANER\TEST\HPWM10_L.PBP	00217	        if PSchanged then             ; set T2 prescaler
	CMPF?TL	_PSchanged, L00035

; C:\USERS\DAMIR\DESKTOP\DANER\TEST\HPWM10_L.PBP	00218	            PSchanged = 0
	MOVE?CT	000h, _PSchanged

; C:\USERS\DAMIR\DESKTOP\DANER\TEST\HPWM10_L.PBP	00219	            T2CKPS0 = PS0
	MOVE?TT	_PS0, _T2CKPS0

; C:\USERS\DAMIR\DESKTOP\DANER\TEST\HPWM10_L.PBP	00220	            T2CKPS1 = PS1
	MOVE?TT	_PS1, _T2CKPS1

; C:\USERS\DAMIR\DESKTOP\DANER\TEST\HPWM10_L.PBP	00221	        endif
	LABEL?L	L00035	

; C:\USERS\DAMIR\DESKTOP\DANER\TEST\HPWM10_L.PBP	00223	        if PR2changed then            ; set PR2
	CMPF?TL	_PR2changed, L00037

; C:\USERS\DAMIR\DESKTOP\DANER\TEST\HPWM10_L.PBP	00224	            PR2changed = 0
	MOVE?CT	000h, _PR2changed

; C:\USERS\DAMIR\DESKTOP\DANER\TEST\HPWM10_L.PBP	00225	            PR2 = HP_PR2
	MOVE?BB	_HP_PR2, PR2

; C:\USERS\DAMIR\DESKTOP\DANER\TEST\HPWM10_L.PBP	00226	        endif
	LABEL?L	L00037	

; C:\USERS\DAMIR\DESKTOP\DANER\TEST\HPWM10_L.PBP	00227	    endif
	LABEL?L	L00031	

; C:\USERS\DAMIR\DESKTOP\DANER\TEST\HPWM10_L.PBP	00228	return
	RETURN?	

; C:\USERS\DAMIR\DESKTOP\DANER\TEST\HPWM10_L.PBP	00231	OverHPWM10:

	LABEL?L	_OverHPWM10	
; C:\USERS\DAMIR\DESKTOP\DANER\TEST\TESTPROGRAM.PBP	00022	DEFINE LCD_DREG PORTA 
; C:\USERS\DAMIR\DESKTOP\DANER\TEST\TESTPROGRAM.PBP	00023	DEFINE LCD_DBIT 0
; C:\USERS\DAMIR\DESKTOP\DANER\TEST\TESTPROGRAM.PBP	00024	DEFINE LCD_RSREG PORTA
; C:\USERS\DAMIR\DESKTOP\DANER\TEST\TESTPROGRAM.PBP	00025	DEFINE LCD_RSBIT 5 
; C:\USERS\DAMIR\DESKTOP\DANER\TEST\TESTPROGRAM.PBP	00026	DEFINE LCD_EREG PORTA
; C:\USERS\DAMIR\DESKTOP\DANER\TEST\TESTPROGRAM.PBP	00027	DEFINE LCD_EBIT 4 
; C:\USERS\DAMIR\DESKTOP\DANER\TEST\TESTPROGRAM.PBP	00028	DEFINE LCD_BITS 4 
; C:\USERS\DAMIR\DESKTOP\DANER\TEST\TESTPROGRAM.PBP	00029	DEFINE LCD_LINE 2
; C:\USERS\DAMIR\DESKTOP\DANER\TEST\TESTPROGRAM.PBP	00031	DEFINE I2C_SCLOUT 1

; C:\USERS\DAMIR\DESKTOP\DANER\TEST\TESTPROGRAM.PBP	00033	OSCCON  = %1111000
	MOVE?CB	078h, OSCCON

; C:\USERS\DAMIR\DESKTOP\DANER\TEST\TESTPROGRAM.PBP	00034	OSCCON2 = %0000000
	MOVE?CB	000h, OSCCON2

; C:\USERS\DAMIR\DESKTOP\DANER\TEST\TESTPROGRAM.PBP	00035	OSCTUNE = %10000000
	MOVE?CB	080h, OSCTUNE

; C:\USERS\DAMIR\DESKTOP\DANER\TEST\TESTPROGRAM.PBP	00036	T1CON = %00000111
	MOVE?CB	007h, T1CON

; C:\USERS\DAMIR\DESKTOP\DANER\TEST\TESTPROGRAM.PBP	00037	ANSELA = 0
	MOVE?CB	000h, ANSELA

; C:\USERS\DAMIR\DESKTOP\DANER\TEST\TESTPROGRAM.PBP	00038	ANSELB = 0
	MOVE?CB	000h, ANSELB

; C:\USERS\DAMIR\DESKTOP\DANER\TEST\TESTPROGRAM.PBP	00039	ANSELC = %000010
	MOVE?CB	002h, ANSELC

; C:\USERS\DAMIR\DESKTOP\DANER\TEST\TESTPROGRAM.PBP	00040	TRISC = %00001000
	MOVE?CB	008h, TRISC

; C:\USERS\DAMIR\DESKTOP\DANER\TEST\TESTPROGRAM.PBP	00041	TRISA = 0
	MOVE?CB	000h, TRISA
; C:\USERS\DAMIR\DESKTOP\DANER\TEST\TESTPROGRAM.PBP	00047	RTC             con %10100010
; C:\USERS\DAMIR\DESKTOP\DANER\TEST\TESTPROGRAM.PBP	00048	EPROM           CON %10100000
; C:\USERS\DAMIR\DESKTOP\DANER\TEST\TESTPROGRAM.PBP	00049	LM75            CON %10010000
; C:\USERS\DAMIR\DESKTOP\DANER\TEST\TESTPROGRAM.PBP	00052	symbol BCKLIGHT        = PORTE.3
; C:\USERS\DAMIR\DESKTOP\DANER\TEST\TESTPROGRAM.PBP	00053	symbol SDA             = PORTC.0
; C:\USERS\DAMIR\DESKTOP\DANER\TEST\TESTPROGRAM.PBP	00054	symbol SCL             = PORTC.1
; C:\USERS\DAMIR\DESKTOP\DANER\TEST\TESTPROGRAM.PBP	00055	symbol TASTATURA       = PORTC.3
; C:\USERS\DAMIR\DESKTOP\DANER\TEST\TESTPROGRAM.PBP	00056	symbol RELEJ1          = PORTC.4
; C:\USERS\DAMIR\DESKTOP\DANER\TEST\TESTPROGRAM.PBP	00057	symbol RELEJ2          = PORTC.5
; C:\USERS\DAMIR\DESKTOP\DANER\TEST\TESTPROGRAM.PBP	00058	symbol TX              = PORTC.6
; C:\USERS\DAMIR\DESKTOP\DANER\TEST\TESTPROGRAM.PBP	00059	symbol RX              = PORTC.7
; C:\USERS\DAMIR\DESKTOP\DANER\TEST\TESTPROGRAM.PBP	00060	symbol BUZZER          = PORTB.1
; C:\USERS\DAMIR\DESKTOP\DANER\TEST\TESTPROGRAM.PBP	00061	symbol COPER           = PORTB.2
; C:\USERS\DAMIR\DESKTOP\DANER\TEST\TESTPROGRAM.PBP	00062	symbol SCLK            = PORTB.4
; C:\USERS\DAMIR\DESKTOP\DANER\TEST\TESTPROGRAM.PBP	00063	symbol DIN             = PORTB.6
; C:\USERS\DAMIR\DESKTOP\DANER\TEST\TESTPROGRAM.PBP	00064	symbol CS              = PORTB.7
; C:\USERS\DAMIR\DESKTOP\DANER\TEST\TESTPROGRAM.PBP	00065	symbol tast1 = PORTA.6
; C:\USERS\DAMIR\DESKTOP\DANER\TEST\TESTPROGRAM.PBP	00066	SYMBOL tast2 = PORTA.7

; C:\USERS\DAMIR\DESKTOP\DANER\TEST\TESTPROGRAM.PBP	00068	input tast1
	INPUT?T	_tast1

; C:\USERS\DAMIR\DESKTOP\DANER\TEST\TESTPROGRAM.PBP	00069	input tast2
	INPUT?T	_tast2

; C:\USERS\DAMIR\DESKTOP\DANER\TEST\TESTPROGRAM.PBP	00071	OUTPUT          BCKLIGHT
	OUTPUT?T	_BCKLIGHT

; C:\USERS\DAMIR\DESKTOP\DANER\TEST\TESTPROGRAM.PBP	00072	INPUT           TASTATURA
	INPUT?T	_TASTATURA

; C:\USERS\DAMIR\DESKTOP\DANER\TEST\TESTPROGRAM.PBP	00073	OUTPUT          RELEJ1
	OUTPUT?T	_RELEJ1

; C:\USERS\DAMIR\DESKTOP\DANER\TEST\TESTPROGRAM.PBP	00074	OUTPUT          RELEJ2
	OUTPUT?T	_RELEJ2

; C:\USERS\DAMIR\DESKTOP\DANER\TEST\TESTPROGRAM.PBP	00075	OUTPUT          BUZZER
	OUTPUT?T	_BUZZER

; C:\USERS\DAMIR\DESKTOP\DANER\TEST\TESTPROGRAM.PBP	00076	OUTPUT          COPER
	OUTPUT?T	_COPER

; C:\USERS\DAMIR\DESKTOP\DANER\TEST\TESTPROGRAM.PBP	00077	output          cs
	OUTPUT?T	_CS

; C:\USERS\DAMIR\DESKTOP\DANER\TEST\TESTPROGRAM.PBP	00078	output          din 
	OUTPUT?T	_DIN

; C:\USERS\DAMIR\DESKTOP\DANER\TEST\TESTPROGRAM.PBP	00079	output          sclk 
	OUTPUT?T	_SCLK

; C:\USERS\DAMIR\DESKTOP\DANER\TEST\TESTPROGRAM.PBP	00080	output tx 
	OUTPUT?T	_TX

; C:\USERS\DAMIR\DESKTOP\DANER\TEST\TESTPROGRAM.PBP	00081	output rx
	OUTPUT?T	_RX

; C:\USERS\DAMIR\DESKTOP\DANER\TEST\TESTPROGRAM.PBP	00082	  trisb=0
	MOVE?CB	000h, TRISB

; C:\USERS\DAMIR\DESKTOP\DANER\TEST\TESTPROGRAM.PBP	00097	Frequency = 30000
	MOVE?CW	000007530h, _Frequency

; C:\USERS\DAMIR\DESKTOP\DANER\TEST\TESTPROGRAM.PBP	00101	 poti = 0
	MOVE?CB	000h, _poti

; C:\USERS\DAMIR\DESKTOP\DANER\TEST\TESTPROGRAM.PBP	00102	gosub UpisiVreme 
	GOSUB?L	_UpisiVreme

; C:\USERS\DAMIR\DESKTOP\DANER\TEST\TESTPROGRAM.PBP	00103	i2cwrite sda,scl,lm75,01,[0,0,0]
	I2CDATA?T	_SDA
	I2CCLOCK?T	_SCL
	I2CWRITE?C	_LM75
	I2CWRITE?C	001h
	I2CWRITE?C	000h
	I2CWRITE?C	000h
	I2CWRITES?C	000h

; C:\USERS\DAMIR\DESKTOP\DANER\TEST\TESTPROGRAM.PBP	00104	    DutyCycleL=512
	MOVE?CW	000000200h, _DutyCycleL

; C:\USERS\DAMIR\DESKTOP\DANER\TEST\TESTPROGRAM.PBP	00106	    @ HPWM10 4, _DutyCycleL, _Frequency

	ASM?
 HPWM10 4, _DutyCycleL, _Frequency

	ENDASM?


; C:\USERS\DAMIR\DESKTOP\DANER\TEST\TESTPROGRAM.PBP	00107	    @ HPWM10 3, _DutyCycleL, _Frequency

	ASM?
 HPWM10 3, _DutyCycleL, _Frequency

	ENDASM?


; C:\USERS\DAMIR\DESKTOP\DANER\TEST\TESTPROGRAM.PBP	00108	    @ HPWM10 2, _DutyCycleL, _Frequency

	ASM?
 HPWM10 2, _DutyCycleL, _Frequency

	ENDASM?


; C:\USERS\DAMIR\DESKTOP\DANER\TEST\TESTPROGRAM.PBP	00109	    @ HPWM10 1, _DutyCycleL, _Frequency

	ASM?
 HPWM10 1, _DutyCycleL, _Frequency

	ENDASM?


; C:\USERS\DAMIR\DESKTOP\DANER\TEST\TESTPROGRAM.PBP	00110	Main:

	LABEL?L	_Main	

; C:\USERS\DAMIR\DESKTOP\DANER\TEST\TESTPROGRAM.PBP	00133	 DutyCycleL = 512   
	MOVE?CW	000000200h, _DutyCycleL

; C:\USERS\DAMIR\DESKTOP\DANER\TEST\TESTPROGRAM.PBP	00136	 Potenciometar.lowbyte = 142
	MOVE?CB	08Eh, _Potenciometar??LOWBYTE

; C:\USERS\DAMIR\DESKTOP\DANER\TEST\TESTPROGRAM.PBP	00137	    gosub PostaviPotenciometar
	GOSUB?L	_PostaviPotenciometar

; C:\USERS\DAMIR\DESKTOP\DANER\TEST\TESTPROGRAM.PBP	00138	Goto Main
	GOTO?L	_Main

; C:\USERS\DAMIR\DESKTOP\DANER\TEST\TESTPROGRAM.PBP	00140	UpisiVreme:

	LABEL?L	_UpisiVreme	

; C:\USERS\DAMIR\DESKTOP\DANER\TEST\TESTPROGRAM.PBP	00141	    Seconds        = $00
	MOVE?CB	000h, _Seconds

; C:\USERS\DAMIR\DESKTOP\DANER\TEST\TESTPROGRAM.PBP	00142	    Minutes        = $00
	MOVE?CB	000h, _Minutes

; C:\USERS\DAMIR\DESKTOP\DANER\TEST\TESTPROGRAM.PBP	00143	    Hours          = $00
	MOVE?CB	000h, _Hours

; C:\USERS\DAMIR\DESKTOP\DANER\TEST\TESTPROGRAM.PBP	00144	    Days           = $01
	MOVE?CB	001h, _Days

; C:\USERS\DAMIR\DESKTOP\DANER\TEST\TESTPROGRAM.PBP	00145	    Years          = $01
	MOVE?CB	001h, _Years

; C:\USERS\DAMIR\DESKTOP\DANER\TEST\TESTPROGRAM.PBP	00146	    Month          = $01
	MOVE?CB	001h, _Month

; C:\USERS\DAMIR\DESKTOP\DANER\TEST\TESTPROGRAM.PBP	00147	    I2cwrite sda,scl,rtc,$02,[seconds,minutes,hours,days,$02,month,years]
	I2CDATA?T	_SDA
	I2CCLOCK?T	_SCL
	I2CWRITE?C	_RTC
	I2CWRITE?C	002h
	I2CWRITE?B	_Seconds
	I2CWRITE?B	_Minutes
	I2CWRITE?B	_Hours
	I2CWRITE?B	_Days
	I2CWRITE?C	002h
	I2CWRITE?B	_Month
	I2CWRITES?B	_Years

; C:\USERS\DAMIR\DESKTOP\DANER\TEST\TESTPROGRAM.PBP	00148	    PAUSE 10 
	PAUSE?C	00Ah

; C:\USERS\DAMIR\DESKTOP\DANER\TEST\TESTPROGRAM.PBP	00149	return 
	RETURN?	

; C:\USERS\DAMIR\DESKTOP\DANER\TEST\TESTPROGRAM.PBP	00151	UzmiVreme: 

	LABEL?L	_UzmiVreme	

; C:\USERS\DAMIR\DESKTOP\DANER\TEST\TESTPROGRAM.PBP	00152	    i2cread sda,scl,rtc,$02,[seconds,minutes,hours,days,temp,month,years]
	I2CDATA?T	_SDA
	I2CCLOCK?T	_SCL
	I2CWRITE?C	_RTC
	I2CWRITE?C	002h
	I2CREAD?B	_Seconds
	I2CREAD?B	_Minutes
	I2CREAD?B	_Hours
	I2CREAD?B	_Days
	I2CREAD?B	_Temp
	I2CREAD?B	_Month
	I2CREADS?B	_Years

; C:\USERS\DAMIR\DESKTOP\DANER\TEST\TESTPROGRAM.PBP	00153	    minutes.7=0:hours.7=0:hours.6=0:days.7=0:days.6=0:month.7=0:month.6=0:month.5=0
	MOVE?CT	000h, _Minutes??7

; C:\USERS\DAMIR\DESKTOP\DANER\TEST\TESTPROGRAM.PBP	00153	    minutes.7=0:hours.7=0:hours.6=0:days.7=0:days.6=0:month.7=0:month.6=0:month.5=0
	MOVE?CT	000h, _Hours??7

; C:\USERS\DAMIR\DESKTOP\DANER\TEST\TESTPROGRAM.PBP	00153	    minutes.7=0:hours.7=0:hours.6=0:days.7=0:days.6=0:month.7=0:month.6=0:month.5=0
	MOVE?CT	000h, _Hours??6

; C:\USERS\DAMIR\DESKTOP\DANER\TEST\TESTPROGRAM.PBP	00153	    minutes.7=0:hours.7=0:hours.6=0:days.7=0:days.6=0:month.7=0:month.6=0:month.5=0
	MOVE?CT	000h, _Days??7

; C:\USERS\DAMIR\DESKTOP\DANER\TEST\TESTPROGRAM.PBP	00153	    minutes.7=0:hours.7=0:hours.6=0:days.7=0:days.6=0:month.7=0:month.6=0:month.5=0
	MOVE?CT	000h, _Days??6

; C:\USERS\DAMIR\DESKTOP\DANER\TEST\TESTPROGRAM.PBP	00153	    minutes.7=0:hours.7=0:hours.6=0:days.7=0:days.6=0:month.7=0:month.6=0:month.5=0
	MOVE?CT	000h, _Month??7

; C:\USERS\DAMIR\DESKTOP\DANER\TEST\TESTPROGRAM.PBP	00153	    minutes.7=0:hours.7=0:hours.6=0:days.7=0:days.6=0:month.7=0:month.6=0:month.5=0
	MOVE?CT	000h, _Month??6

; C:\USERS\DAMIR\DESKTOP\DANER\TEST\TESTPROGRAM.PBP	00153	    minutes.7=0:hours.7=0:hours.6=0:days.7=0:days.6=0:month.7=0:month.6=0:month.5=0
	MOVE?CT	000h, _Month??5

; C:\USERS\DAMIR\DESKTOP\DANER\TEST\TESTPROGRAM.PBP	00154	return
	RETURN?	

; C:\USERS\DAMIR\DESKTOP\DANER\TEST\TESTPROGRAM.PBP	00156	OcitajTemperaturu:

	LABEL?L	_OcitajTemperaturu	

; C:\USERS\DAMIR\DESKTOP\DANER\TEST\TESTPROGRAM.PBP	00157	    LMcnt=LMcnt+1
	ADD?BCB	_LMcnt, 001h, _LMcnt

; C:\USERS\DAMIR\DESKTOP\DANER\TEST\TESTPROGRAM.PBP	00159	     I2CREAD  sda, scl, lm75, 0,[Temperatura]
	I2CDATA?T	_SDA
	I2CCLOCK?T	_SCL
	I2CWRITE?C	_LM75
	I2CWRITE?C	000h
	I2CREADS?B	_Temperatura

; C:\USERS\DAMIR\DESKTOP\DANER\TEST\TESTPROGRAM.PBP	00160	return 
	RETURN?	

; C:\USERS\DAMIR\DESKTOP\DANER\TEST\TESTPROGRAM.PBP	00162	PostaviPotenciometar:

	LABEL?L	_PostaviPotenciometar	

; C:\USERS\DAMIR\DESKTOP\DANER\TEST\TESTPROGRAM.PBP	00165	    LOW CS
	LOW?T	_CS

; C:\USERS\DAMIR\DESKTOP\DANER\TEST\TESTPROGRAM.PBP	00166	    PAUSEUS 100
	PAUSEUS?C	064h

; C:\USERS\DAMIR\DESKTOP\DANER\TEST\TESTPROGRAM.PBP	00167	    Potenciometar.9 = 0
	MOVE?CT	000h, _Potenciometar??9

; C:\USERS\DAMIR\DESKTOP\DANER\TEST\TESTPROGRAM.PBP	00168	    SHIFTOUT din,sclk, 1,[Potenciometar\9]
	SHIFTDATA?T	_DIN
	SHIFTCLOCK?T	_SCLK
	SHIFTMODE?C	001h
	SHIFTOUT?WC	_Potenciometar, 009h

; C:\USERS\DAMIR\DESKTOP\DANER\TEST\TESTPROGRAM.PBP	00170	    Potenciometar.9 = 1
	MOVE?CT	001h, _Potenciometar??9

; C:\USERS\DAMIR\DESKTOP\DANER\TEST\TESTPROGRAM.PBP	00172	    SHIFTOUT din,sclk,1,[Potenciometar\9]
	SHIFTDATA?T	_DIN
	SHIFTCLOCK?T	_SCLK
	SHIFTMODE?C	001h
	SHIFTOUT?WC	_Potenciometar, 009h

; C:\USERS\DAMIR\DESKTOP\DANER\TEST\TESTPROGRAM.PBP	00173	    HIGH CS
	HIGH?T	_CS

; C:\USERS\DAMIR\DESKTOP\DANER\TEST\TESTPROGRAM.PBP	00174	return
	RETURN?	

; C:\USERS\DAMIR\DESKTOP\DANER\TEST\TESTPROGRAM.PBP	00177	END
	END?	

	END
